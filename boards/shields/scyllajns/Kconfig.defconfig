## boards/shields/scyllajns/Kconfig.defconfig
```kconfig
# Copyright (c) 2020 The ZMK Contributors
# SPDX-License-Identifier: MIT

if SHIELD_SCYLLAJNS_DONGLE
    config ZMK_KEYBOARD_NAME
        default "ScyllaJNS"
    config ZMK_SPLIT_ROLE_CENTRAL
        default y
    config ZMK_SPLIT
        default y
    config ZMK_SPLIT_BLE_CENTRAL_PERIPHERALS
        default 2
    config BT_MAX_CONN
        default 7
    config BT_MAX_PAIRED
        default 7
    config ZMK_USB
        default y
    config ZMK_BLE
        default y
endif

if SHIELD_SCYLLAJNS_LEFT || SHIELD_SCYLLAJNS_RIGHT
    config ZMK_SPLIT
        default y
    config ZMK_BLE
        default y
endif

if SHIELD_SSCYLLAJNS_RIGHT
    config EC11
        default y
endif
```

## boards/shields/scyllajns/Kconfig.shield
```kconfig
# Copyright (c) 2020 The ZMK Contributors
# SPDX-License-Identifier: MIT

config SHIELD_SCYLLAJNS_LEFT
	def_bool $(shields_list_contains,scyllajns_left)

config SHIELD_SCYLLAJNS_RIGHT
	def_bool $(shields_list_contains,scyllajns_right)

config SHIELD_SCYLLAJNS_DONGLE
	def_bool $(shields_list_contains,scyllajns_dongle)
```
